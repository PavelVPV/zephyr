## CMakeLists.txt
```
#
# Copyright (c) 2021 Nordic Semiconductor ASA
#
# SPDX-License-Identifier: LicenseRef-Nordic-5-Clause
#
cmake_minimum_required(VERSION 3.20.0)

find_package(Zephyr REQUIRED HINTS $ENV{ZEPHYR_BASE})
project(bt_mesh_fuzzy_test)

FILE(GLOB app_sources src/*.c)

target_sources(app
  PRIVATE
  ${app_sources}
  ${ZEPHYR_BASE}/subsys/bluetooth/mesh/main.c
  ${ZEPHYR_BASE}/subsys/bluetooth/mesh/cfg.c
  ${ZEPHYR_BASE}/subsys/bluetooth/mesh/adv.c
  ${ZEPHYR_BASE}/subsys/bluetooth/mesh/beacon.c
  ${ZEPHYR_BASE}/subsys/bluetooth/mesh/net.c
  ${ZEPHYR_BASE}/subsys/bluetooth/mesh/subnet.c
  ${ZEPHYR_BASE}/subsys/bluetooth/mesh/app_keys.c
  ${ZEPHYR_BASE}/subsys/bluetooth/mesh/heartbeat.c
  ${ZEPHYR_BASE}/subsys/bluetooth/mesh/crypto.c
  ${ZEPHYR_BASE}/subsys/bluetooth/mesh/access.c
  ${ZEPHYR_BASE}/subsys/bluetooth/mesh/msg.c
  ${ZEPHYR_BASE}/subsys/bluetooth/mesh/rpl.c
  ${ZEPHYR_BASE}/subsys/bluetooth/mesh/settings.c
  ${ZEPHYR_BASE}/subsys/bluetooth/mesh/transport.c
  ${ZEPHYR_BASE}/subsys/bluetooth/mesh/cfg_srv.c
  ${ZEPHYR_BASE}/subsys/bluetooth/mesh/cfg_cli.c
  ${ZEPHYR_BASE}/subsys/bluetooth/mesh/health_srv.c

  ${ZEPHYR_BASE}/subsys/net/buf.c
  ${ZEPHYR_BASE}/subsys/net/buf_simple.c

  ${ZEPHYR_BASE}/../modules/crypto/tinycrypt/lib/source/ecc_platform_specific.c
  )

target_include_directories(app
  PRIVATE
  ${ZEPHYR_BASE}/subsys/bluetooth/mesh
  ${ZEPHYR_BASE}/subsys/bluetooth
  ${ZEPHYR_BASE}/../modules/crypto/tinycrypt/lib/include
  ${ZEPHYR_BASE}/include/zephyr/bluetooth
  ${ZEPHYR_BASE}/include/zephyr/settings
  )

target_compile_options(app
  PRIVATE
  -DCONFIG_BT_MESH
  -DCONFIG_BT_MESH_UNPROV_BEACON_INT=10
  -DCONFIG_BT_MESH_DEFAULT_TTL=3
  -DCONFIG_BT_MESH_NETWORK_TRANSMIT_COUNT=1
  -DCONFIG_BT_MESH_NETWORK_TRANSMIT_INTERVAL=10
  -DCONFIG_BT_MESH_LOG_LEVEL=0
  -DCONFIG_BT_MESH_SUBNET_COUNT=1
  -DCONFIG_BT_MESH_APP_KEY_COUNT=1
  -DCONFIG_BT_MESH_CRPL=32
  -DCONFIG_BT_MESH_IV_UPDATE_SEQ_LIMIT=10
  -DCONFIG_BT_MESH_IVU_DIVIDER=1
  -DCONFIG_BT_MESH_MSG_CACHE_SIZE=10
  -DCONFIG_BT_MESH_ADV_BUF_COUNT=10
  -DCONFIG_BT_MESH_LOOPBACK_BUFS=10
  -DCONFIG_BT_MESH_MODEL_KEY_COUNT=5
  -DCONFIG_BT_MESH_MODEL_GROUP_COUNT=5
  -DCONFIG_BT_MESH_TX_SEG_MSG_COUNT=32
  -DCONFIG_BT_MESH_RX_SEG_MSG_COUNT=32
  -DCONFIG_BT_MESH_SEG_BUFS=255
  -DCONFIG_BT_MESH_LABEL_COUNT=1
  -DCONFIG_BT_MESH_CFG_CLI_TIMEOUT=5
  -UCONFIG_BT_SETTINGS
  -DCONFIG_BT_LOG_LEVEL=0
  -DCONFIG_BT_ID_MAX=1
  -DCONFIG_BT_MESH_STORE_TIMEOUT=10
  -UCONFIG_LOG
  -DCONFIG_NET_BUF_LOG_LEVEL=0
)

zephyr_ld_options(
    ${LINKERFLAGPREFIX},--allow-multiple-definition
    )
```

## prj.conf
```kconfig
#
# Copyright (c) 2021 Nordic Semiconductor ASA
#
# SPDX-License-Identifier: LicenseRef-Nordic-5-Clause
#

# Ztest configuration
CONFIG_ZTEST=y
CONFIG_ZTEST_NEW_API=y
CONFIG_ZTEST_MOCKING=y
CONFIG_ZTEST_PARAMETER_COUNT=30

CONFIG_TINYCRYPT=y
CONFIG_TINYCRYPT_ECC_DH=y
CONFIG_TINYCRYPT_AES=y
CONFIG_TINYCRYPT_AES_CMAC=y
CONFIG_TINYCRYPT_SHA256=y
CONFIG_TINYCRYPT_SHA256_HMAC=y

CONFIG_BT_DEBUG_LOG=n
CONFIG_LOG=n
CONFIG_TEST_LOGGING_DEFAULTS=n

CONFIG_ARCH_POSIX_LIBFUZZER=y
CONFIG_ASAN=y

CONFIG_ASSERT_TEST=y

CONFIG_NO_OPTIMIZATIONS=y
```

## src/main.c
```c
/*
 * Copyright (c) 2021 Nordic Semiconductor ASA
 *
 * SPDX-License-Identifier: LicenseRef-Nordic-5-Clause
 */

#include <stdio.h>
#include <stdint.h>
//#include <zephyr/ztest.h>
#include <zephyr/bluetooth/mesh.h>
//#include "../../../../../subsys/bluetooth/hci/hci_core.h"
#include <conn.h>
#include <host/hci_core.h>
#include <net.h>

int bt_encrypt_be(const uint8_t key[16], const uint8_t plaintext[16],
		  uint8_t enc_data[16])
{ return 0; }

int bt_encrypt_le(const uint8_t key[16], const uint8_t plaintext[16],
		  uint8_t enc_data[16])
{ return 0; }

int bt_ccm_encrypt(const uint8_t key[16], uint8_t nonce[13],
		   const uint8_t *plaintext, size_t len, const uint8_t *aad,
		   size_t aad_len, uint8_t *enc_data, size_t mic_size)
{ return 0; }

int bt_ccm_decrypt(const uint8_t key[16], uint8_t nonce[13],
		   const uint8_t *enc_data, size_t len, const uint8_t *aad,
		   size_t aad_len, uint8_t *plaintext, size_t mic_size)
{ return 0; }

int bt_mesh_adv_enable(void)
{ return 0; }

void bt_mesh_adv_init(void)
{}

int settings_save_one(const char *name, const void *value, size_t val_len)
{ return 0; }

int settings_delete(const char *name)
{ return 0; }

void bt_mesh_adv_buf_local_ready(void)
{}

int bt_le_scan_stop(void)
{ return 0; }

int bt_le_scan_start(const struct bt_le_scan_param *param, bt_le_scan_cb_t cb)
{ return 0; }

const char *bt_hex(const void *buf, size_t len)
{ return ""; }

int settings_name_next(const char *name, const char **next)
{ return 0; }

struct bt_dev bt_dev;

#if 0
static void setup(void *f)
{
	IRQ_CONNECT(CONFIG_ARCH_POSIX_FUZZ_IRQ, 0, fuzz_isr, NULL, 0);
	irq_enable(CONFIG_ARCH_POSIX_FUZZ_IRQ);

	printf("setup\n");
}

static void teardown(void *f)
{
	printf("teardown\n");
}

ZTEST(mesh_test_suite, test_stub)
{
	printf("test_stub\n");
}

ZTEST_SUITE(mesh_test_suite, NULL, NULL, setup, teardown, NULL);
#endif

extern uint8_t *posix_fuzz_buf, posix_fuzz_sz;

static void fuzz_work_handler(struct k_work *work)
{
	struct net_buf_simple buf;

	net_buf_simple_init_with_data(&buf, posix_fuzz_buf, posix_fuzz_sz);
	bt_mesh_scan_cb(NULL, 0, BT_GAP_ADV_TYPE_ADV_NONCONN_IND, &buf);
}

static struct k_work fuzz_work = Z_WORK_INITIALIZER(fuzz_work_handler);
K_SEM_DEFINE(fuzz_sem, 0, K_SEM_MAX_LIMIT);

static void fuzz_isr(const void *arg)
{
//	k_work_submit(&fuzz_work);

	k_sem_give(&fuzz_sem);
}

static struct bt_mesh_cfg_cli cfg_cli;

static struct bt_mesh_model root_models[] = {
	BT_MESH_MODEL_CFG_SRV,
	BT_MESH_MODEL_CFG_CLI(&cfg_cli),
};

static struct bt_mesh_elem elements[] = {
	BT_MESH_ELEM(0, root_models, BT_MESH_MODEL_NONE),
};

static const struct bt_mesh_comp comp = {
	.cid = 0x0001,
	.elem = elements,
	.elem_count = ARRAY_SIZE(elements),
};

static const struct bt_mesh_prov prov = {
};

void main(void)
{
	int err;

	printk("Initializing...\n");

	atomic_set_bit(bt_mesh.flags, BT_MESH_VALID);

	bt_mesh_init(&prov, &comp);
//	bt_mesh_comp_register(&comp);
	bt_mesh_subnet_add(0, (uint8_t[]){1,2,3,4,5,6,7,8,9,10,11,12,13,14,15,16});

	IRQ_CONNECT(CONFIG_ARCH_POSIX_FUZZ_IRQ, 0, fuzz_isr, NULL, 0);
	irq_enable(CONFIG_ARCH_POSIX_FUZZ_IRQ);

	while (true) {
#if 1
		k_sem_take(&fuzz_sem, K_FOREVER);

		/* Execute the fuzz case we got from LLVM and passed
		 * through an interrupt to this thread.
		 */
		fuzz_work_handler(NULL);
#endif
	}
}
```
