## prj.conf
```kconfig
CONFIG_BT=y
CONFIG_BT_PERIPHERAL=y
CONFIG_BT_CENTRAL=y
CONFIG_BT_PRIVACY=y

CONFIG_BT_DEVICE_NAME="Multiple"

CONFIG_BT_USER_PHY_UPDATE=y
CONFIG_BT_AUTO_PHY_PERIPHERAL_2M=y
CONFIG_BT_USER_DATA_LEN_UPDATE=y
CONFIG_BT_AUTO_DATA_LEN_UPDATE=y

# Maximum simultaneous ACL connections, current maximum considering other roles
# using ticker nodes count up to 255 (UINT8_MAX)
CONFIG_BT_MAX_CONN=250
CONFIG_BT_ID_MAX=250

# Avoid using the PPCP provided connection interval so that the multiple
# connections are kept non-overlapping as initially scheduled at connection
# setup
CONFIG_BT_GAP_AUTO_UPDATE_CONN_PARAMS=n

# Enables simultaneous MTU exchange in the test
CONFIG_BT_GATT_CLIENT=y

# Enables simultaneous SMP pairing procedures
CONFIG_BT_SMP=y
CONFIG_BT_MAX_PAIRED=250

CONFIG_BT_L2CAP_TX_MTU=247

# Buffer sizes
CONFIG_BT_BUF_CMD_TX_SIZE=255
CONFIG_BT_BUF_EVT_RX_SIZE=255
CONFIG_BT_BUF_EVT_DISCARDABLE_SIZE=255
CONFIG_BT_BUF_ACL_TX_SIZE=251
CONFIG_BT_BUF_ACL_RX_SIZE=251

# Increase the number of buffers to avoid deadlocks
CONFIG_BT_BUF_EVT_RX_COUNT=4

# Use Data Length Extensions
CONFIG_BT_CTLR_DATA_LENGTH_MAX=251

# Each PHY update can pause connections for 6 interval hence to let other
# parallel connection establishment to succeed increase Rx buffer count.
# A minimum of 1 Rx buffer is required to receive data PDU, during control
# procedures Rx buffer could be held, preventing new connections to be
# established, a value of 3 is tuned based on this test case execution for 2
# iterations. If there is buffer leak, simulated by using value of 2 here, the
# test is failing.
# If there is buffer leak, this test now should catch it.
CONFIG_BT_CTLR_RX_BUFFERS=3

# Provide enough spacing between connections so that multiple peripheral roles
# when connected to a single peer device (peripheral_identity sample) have
# room for window widening and do not overlap with each other in that single
# peer device. This can be tuned based on connection interval and clock
# accuracy, current value here is sufficient for 500ppm at 1 second interval and
# considering required connection event length for 251 byte PDU on 2M PHY.
# (Event Overhead + Radio Ready Delay + Rx window + 1064 + 154 + 1064)
CONFIG_BT_CTLR_ADVANCED_FEATURES=y
CONFIG_BT_CTLR_CENTRAL_SPACING=3750

# Do not use max data PDU size time reservation for connection events spacing
# instead use lesser value as supplied in CONFIG_BT_CTLR_CENTRAL_SPACING
CONFIG_BT_CTLR_CENTRAL_RESERVE_MAX=n
CONFIG_BT_CTLR_SLOT_RESERVATION_UPDATE=n

# Enable these 2 Kconfig options to allow Host to replace old bond with new one
# when using the same identity address for testing.
CONFIG_BT_ID_UNPAIR_MATCHING_BONDS=y
CONFIG_BT_SMP_ALLOW_UNAUTH_OVERWRITE=y

# Disable the boot banner and printk to avoid flooding the console with logs.
# Enable them back if needed, for example, when test fails and you want to see
# the logs.
CONFIG_LOG=y
#CONFIG_BOOT_BANNER=n
#CONFIG_PRINTK=n
#CONFIG_BT_HCI_ACL_FLOW_CONTROL=y
```

## overlay-nrf5340_cpunet_iso-bt_ll_sw_split.conf
```kconfig
# Maximum simultaneous ACL connections, today's maximum considering other
# roles using ticker nodes count up to 255 (UINT8_MAX) in the hci_ipc with ISO
# support
CONFIG_BT_MAX_CONN=231

# Each PHY update can pause connections for 6 interval hence to let other
# parallel connection establishment to succeed increase Rx buffer count.
# A minimum of 1 Rx buffer is required to receive data PDU, during control
# procedures Rx buffer could be held, preventing new connections to be
# established, a value of 3 is tuned based on this test case execution for 2
# iterations. If there is buffer leak, simulated by using value of 2 here, the
# test is failing.
# If there is buffer leak, this test now should catch it.
CONFIG_BT_CTLR_RX_BUFFERS=3

# Provide enough spacing between connections so that multiple peripheral roles
# when connected to a single peer device (peripheral_identity sample) have
# room for window widening and do not overlap with each other in that single
# peer device. This can be tuned based on connection interval and clock
# accuracy, current value here is sufficient for 500ppm at 1 second interval and
# considering required connection event length for 251 byte PDU on 2M PHY.
# (Event Overhead + Radio Ready Delay + Rx window + 1064 + 154 + 1064)
CONFIG_BT_CTLR_ADVANCED_FEATURES=y
CONFIG_BT_CTLR_CENTRAL_SPACING=3750

# Do not use max data PDU size time reservation for connection events spacing
# instead use lesser value as supplied in CONFIG_BT_CTLR_CENTRAL_SPACING
CONFIG_BT_CTLR_CENTRAL_RESERVE_MAX=n
CONFIG_BT_CTLR_SLOT_RESERVATION_UPDATE=n

# Required maximum simultaneous LLCP contexts
CONFIG_BT_CTLR_LLCP_LOCAL_PROC_CTX_BUF_NUM=231

CONFIG_LOG=y

#CONFIG_BT_BUF_EVT_RX_COUNT=14
```

## src/main.c
```c
/* main.c - Application main entry point */

/*
 * Copyright (c) 2015-2016 Intel Corporation
 *
 * SPDX-License-Identifier: Apache-2.0
 */

#include <stddef.h>

#include <zephyr/kernel.h>

#include <zephyr/sys/printk.h>
#include <zephyr/sys/util.h>

#include "bs_types.h"
#include "bs_tracing.h"
#include "time_machine.h"
#include "bstests.h"

/* The test case is performing 250 simultaneous connections and managing
 * parallel control procedures utilizing the available/configured minimum
 * buffer counts. Hence, two iterations of connect-disconnect should be
 * sufficient to catch any regressions/buffer leaks.
 */
#define ITERATIONS 2

int init_central(uint8_t max_conn, uint8_t iterations);
int init_peripheral(uint8_t max_conn, uint8_t iterations);

#define FAIL(...)					\
	do {						\
		bst_result = Failed;			\
		bs_trace_error_time_line(__VA_ARGS__);	\
	} while (0)

#define PASS(...)					\
	do {						\
		bst_result = Passed;			\
		bs_trace_info_time(1, __VA_ARGS__);	\
	} while (0)

extern enum bst_result_t bst_result;

static void test_central_main(void)
{
	int err;

	err = init_central(CONFIG_BT_MAX_CONN, ITERATIONS);
	if (err) {
		goto exit;
	}

	/* Wait a little so that peripheral side completes the last
	 * connection establishment.
	 */
	k_sleep(K_SECONDS(1));

	PASS("Central tests passed\n");

	return;

exit:
	FAIL("Central tests failed (%d)\n", err);
	bs_trace_silent_exit(0);
}

static void test_peripheral_main(void)
{
	int err;

	err = init_peripheral(CONFIG_BT_MAX_CONN, ITERATIONS);
	if (err) {
		goto exit;
	}

	PASS("Peripheral tests passed\n");

	return;

exit:
	FAIL("Peripheral tests failed (%d)\n", err);
	bs_trace_silent_exit(0);
}

static void test_central_multiple_main(void)
{
	int err;

	err = init_central(20U, ITERATIONS);
	if (err) {
		goto exit;
	}

	/* Wait a little so that peripheral side completes the last
	 * connection establishment.
	 */
	k_sleep(K_SECONDS(1));

	PASS("Central tests passed\n");

	return;

exit:
	FAIL("Central tests failed (%d)\n", err);
	bs_trace_silent_exit(0);
}

static void test_peripheral_single_main(void)
{
	int err;

	err = init_peripheral(1U, ITERATIONS);
	if (err) {
		goto exit;
	}

	PASS("Peripheral tests passed\n");

	return;

exit:
	FAIL("Peripheral tests failed (%d)\n", err);
	bs_trace_silent_exit(0);
}

static void test_central_single_main(void)
{
	int err;

	err = init_central(1U, ITERATIONS);
	if (err) {
		goto exit;
	}

	PASS("Central tests passed\n");

	return;

exit:
	FAIL("Central tests failed (%d)\n", err);
	bs_trace_silent_exit(0);
}

static void test_peripheral_multilink_main(void)
{
	int err;

	err = init_peripheral(20U, ITERATIONS);
	if (err) {
		goto exit;
	}

	k_sleep(K_SECONDS(3));

	PASS("Peripheral tests passed\n");

	return;

exit:
	FAIL("Peripheral tests failed (%d)\n", err);
	bs_trace_silent_exit(0);
}

static void test_multiple_init(void)
{
	bst_ticker_set_next_tick_absolute(2500e6);
	bst_result = In_progress;
}

static void test_multiple_tick(bs_time_t HW_device_time)
{
	if (bst_result != Passed) {
		FAIL("Test timeout (not passed after %i seconds)", HW_device_time / USEC_PER_SEC);
	}

	bs_trace_silent_exit(0);
}

static const struct bst_test_instance test_def[] = {
	{
		.test_id = "central",
		.test_descr = "Central Multilink",
		.test_pre_init_f = test_multiple_init,
		.test_tick_f = test_multiple_tick,
		.test_main_f = test_central_main
	},
	{
		.test_id = "peripheral",
		.test_descr = "Peripheral multiple identity",
		.test_pre_init_f = test_multiple_init,
		.test_tick_f = test_multiple_tick,
		.test_main_f = test_peripheral_main
	},
	{
		.test_id = "central_multiple",
		.test_descr = "Single Central Multilink device",
		.test_pre_init_f = test_multiple_init,
		.test_tick_f = test_multiple_tick,
		.test_main_f = test_central_multiple_main
	},
	{
		.test_id = "peripheral_single",
		.test_descr = "Many Peripheral single link device",
		.test_pre_init_f = test_multiple_init,
		.test_tick_f = test_multiple_tick,
		.test_main_f = test_peripheral_single_main
	},
	{
		.test_id = "central_single",
		.test_descr = "Single Central device",
		.test_pre_init_f = test_multiple_init,
		.test_tick_f = test_multiple_tick,
		.test_main_f = test_central_single_main
	},
	{
		.test_id = "peripheral_multilink",
		.test_descr = "Peripheral multilink device",
		.test_pre_init_f = test_multiple_init,
		.test_tick_f = test_multiple_tick,
		.test_main_f = test_peripheral_multilink_main
	},
	BSTEST_END_MARKER
};

struct bst_test_list *test_multiple_install(struct bst_test_list *tests)
{
	return bst_add_tests(tests, test_def);
}

bst_test_install_t test_installers[] = {
	test_multiple_install,
	NULL
};

int main(void)
{
	bst_main();
	return 0;
}
```
