## tests/bsim/bluetooth/host/central/testcase.yaml
```yaml
tests:
  bluetooth.host.central:
    build_only: true
    sysbuild: true
    tags:
      - bluetooth
    platform_allow:
      - nrf52_bsim/native
      - nrf5340bsim/nrf5340/cpunet
      - nrf5340bsim/nrf5340/cpuapp
    harness: bsim
    harness_config:
      bsim_exe_name: tests_bsim_bluetooth_host_central_prj_conf
```

## tests/bsim/bluetooth/host/misc/conn_stress/central/testcase.yaml
```yaml
tests:
  bluetooth.host.misc.conn_stress.central:
    build_only: true
    tags:
      - bluetooth
    platform_allow:
      - nrf52_bsim/native
      - nrf5340bsim/nrf5340/cpuapp
    harness: bsim
    harness_config:
      bsim_exe_name: tests_bsim_bluetooth_host_misc_conn_stress_central_prj_conf
```

## tests/bsim/bluetooth/host/misc/iso_acl_stress/testcase.yaml
```yaml
tests:
  bluetooth.host.misc.iso_acl_stress:
    build_only: true
    tags:
      - bluetooth
    platform_allow:
      - nrf52_bsim/native
    harness: bsim
    harness_config:
      bsim_exe_name: tests_bsim_bluetooth_host_misc_iso_acl_stress_prj_conf
```

## tests/net/wifi/wifi_nm/testcase.yaml
```yaml
common:
  depends_on: netif
  min_ram: 32
  extra_args:
    # Will be ignored for other platforms
    - CONFIG_BUILD_ONLY_NO_BLOBS=y
  tags:
    - wifi
    - net
  platform_exclude:
    - rd_rw612_bga/rw612/ethernet # Requires binary blobs to build
    - frdm_rw612 # Requires binary blobs to build
    - arduino_giga_r1/stm32h747xx/m7 # Requires binary blobs to build
    - arduino_nicla_vision/stm32h747xx/m7 # Requires binary blobs to build
    - arduino_portenta_h7/stm32h747xx/m7 # Requires binary blobs to build
    - arduino_portenta_h7@4.10.0/stm32h747xx/m7 # Requires binary blobs to build
tests:
  net.wifi:
    # Synchronous (legacy) connect/disconnect path.
    extra_configs:
      - CONFIG_WIFI_MGMT_DEFER_OPS=n
  net.wifi.defer:
    # Connect/disconnect deferred to the Wi-Fi management workqueue.
    extra_configs:
      - CONFIG_WIFI_MGMT_DEFER_OPS=y
```
