## prj.conf
```kconfig
CONFIG_BT=y
CONFIG_BT_DEVICE_NAME="GATT tester"
CONFIG_BT_PERIPHERAL=y
CONFIG_BT_CENTRAL=y
CONFIG_BT_GATT_CLIENT=y

CONFIG_BT_GATT_AUTO_DISCOVER_CCC=y

CONFIG_BT_MAX_CONN=5
CONFIG_BT_MAX_PAIRED=5

CONFIG_BT_SMP=y
CONFIG_BT_L2CAP_DYNAMIC_CHANNEL=y
CONFIG_BT_L2CAP_ECRED=y
CONFIG_BT_EATT=y

CONFIG_BT_AUTO_PHY_UPDATE=n
CONFIG_BT_AUTO_DATA_LEN_UPDATE=n

CONFIG_ASSERT=y
CONFIG_BT_TESTING=y
CONFIG_LOG=y

# Maximum possible EATT channels are used to parallelize notifications as much as possible,
# increasing traffic towards Central.
CONFIG_BT_EATT_MAX=16

# This is aligned with CONFIG_BT_EATT_MAX to utilize all EATT channels
CONFIG_BT_BUF_ACL_TX_COUNT=16

# Aligned with characteristic size
CONFIG_BT_BUF_ACL_RX_SIZE=70
CONFIG_BT_BUF_ACL_TX_SIZE=70

CONFIG_BT_BUF_EVT_RX_COUNT=17
CONFIG_BT_BUF_ACL_RX_COUNT_EXTRA=0

CONFIG_BT_BUF_CMD_TX_COUNT=2
CONFIG_NET_BUF_POOL_USAGE=y
```

## nrf5340_cpunet-bt_ll_sw_split.conf
```kconfig
CONFIG_LOG=y
CONFIG_IPC_SERVICE=y
CONFIG_MBOX=y
CONFIG_ISR_STACK_SIZE=1024
CONFIG_IDLE_STACK_SIZE=256
CONFIG_MAIN_STACK_SIZE=512
CONFIG_SYSTEM_WORKQUEUE_STACK_SIZE=512
CONFIG_IPC_SERVICE_BACKEND_RPMSG_WQ_STACK_SIZE=512
CONFIG_HEAP_MEM_POOL_SIZE=4096
CONFIG_CBPRINTF_REDUCED_INTEGRAL=y
CONFIG_ISR_TABLES_LOCAL_DECLARATION=y

CONFIG_BT=y
CONFIG_BT_HCI_RAW=y
CONFIG_BT_MAX_CONN=3

# Controller
CONFIG_BT_LL_SW_SPLIT=y
CONFIG_BT_CTLR_ASSERT_HANDLER=y

CONFIG_BT_CTLR_DATA_LENGTH_MAX=120
CONFIG_BT_CTLR_ADV_DATA_LEN_MAX=191
CONFIG_BT_CTLR_RX_BUFFERS=10

CONFIG_BT_BUF_CMD_TX_SIZE=65
CONFIG_BT_BUF_EVT_RX_SIZE=68
CONFIG_BT_BUF_EVT_RX_COUNT=17
CONFIG_BT_BUF_ACL_TX_COUNT=16
CONFIG_BT_BUF_ACL_TX_SIZE=120
CONFIG_BT_BUF_ACL_RX_SIZE=120
CONFIG_BT_BUF_ACL_RX_COUNT_EXTRA=0

CONFIG_BT_CTLR_PHY_CODED=n
```

## src/bs_sync.c
```c
/* Copyright (c) 2023 Nordic Semiconductor ASA
 * SPDX-License-Identifier: Apache-2.0
 */

#include <stdint.h>
#include <argparse.h>
#include <posix_native_task.h>
#include <bs_pc_backchannel.h>

#include <zephyr/logging/log.h>
#include <zephyr/sys/byteorder.h>
#include <bs_tracing.h>
#include <zephyr/kernel.h>
LOG_MODULE_REGISTER(bs_sync, LOG_LEVEL_INF);

static int n_devs = 4;

static void register_more_cmd_args(void)
{
	static bs_args_struct_t args_struct_toadd[] = {
		{
			.option = "D",
			.name = "number_devices",
			.type = 'i',
			.dest = (void *)&n_devs,
			.descript = "Number of devices which will connect in this phy",
			.is_mandatory = true,
		},
		ARG_TABLE_ENDMARKER,
	};

	bs_add_extra_dynargs(args_struct_toadd);
}
NATIVE_TASK(register_more_cmd_args, PRE_BOOT_1, 100);

static uint *backchannels;
static void setup_backchannels(void)
{
	__ASSERT_NO_MSG(n_devs > 0);
	uint self = get_device_nbr();
	uint device_nbrs[n_devs];
	uint channel_numbers[n_devs];

	for (int i = 0; i < n_devs; i++) {
		device_nbrs[i] = i;
		channel_numbers[i] = 0;
	}

	backchannels =
		bs_open_back_channel(self, device_nbrs, channel_numbers, ARRAY_SIZE(device_nbrs));
	__ASSERT_NO_MSG(backchannels != NULL);
}
NATIVE_TASK(setup_backchannels, PRE_BOOT_3, 100);

void bs_bc_receive_msg_sync(uint ch, size_t size, uint8_t *data)
{
	while (bs_bc_is_msg_received(ch) < size) {
		k_msleep(1);
	}
	bs_bc_receive_msg(ch, data, size);
}

void bs_bc_send_uint(uint ch, uint64_t data)
{
	uint8_t data_bytes[sizeof(data)];

	sys_put_le64(data, data_bytes);
	bs_bc_send_msg(ch, data_bytes, sizeof(data_bytes));
}

uint64_t bs_bc_recv_uint(uint ch)
{
	uint8_t data[sizeof(uint64_t)];

	bs_bc_receive_msg_sync(ch, sizeof(data), data);
	return sys_get_le64(data);
}

void bt_testlib_bs_sync_all(void)
{
	static uint64_t counter;

	LOG_DBG("%llu d%u enter", counter, get_device_nbr());

	/* Device 0 acts as hub. */
	if (get_device_nbr() == 0) {
		for (int i = 1; i < n_devs; i++) {
			uint64_t counter_cfm;

			counter_cfm = bs_bc_recv_uint(backchannels[i]);
			__ASSERT(counter_cfm == counter, "%luu %luu", counter_cfm, counter);
		}
		for (int i = 1; i < n_devs; i++) {
			bs_bc_send_uint(backchannels[i], counter);
		}
	} else {
		uint64_t counter_cfm;

		bs_bc_send_uint(backchannels[0], counter);
		counter_cfm = bs_bc_recv_uint(backchannels[0]);
		__ASSERT(counter_cfm == counter, "%luu %luu", counter_cfm, counter);
	}

	LOG_DBG("%llu d%u exit", counter, get_device_nbr());

	counter++;
}
```

## src/common.h
```c
/**
 * Common macros used by both sides of the test
 *
 * Copyright (c) 2025 Nordic Semiconductor ASA
 *
 * SPDX-License-Identifier: Apache-2.0
 */

#include <zephyr/toolchain.h>

#define CHRC_SIZE 110

#define TEST_SERVICE_UUID                                                                          \
	BT_UUID_DECLARE_128(0x01, 0x23, 0x45, 0x67, 0x89, 0x01, 0x02, 0x03, 0x04, 0x05, 0x06,      \
			    0x07, 0x08, 0x09, 0x00, 0x00)

#define TEST_CHRC_UUID                                                                             \
	BT_UUID_DECLARE_128(0x01, 0x23, 0x45, 0x67, 0x89, 0x01, 0x02, 0x03, 0x04, 0x05, 0x06,      \
			    0x07, 0x08, 0x09, 0xFF, 0x11)

#define NOTIFICATION_COUNT 60
```

## src/gatt_client_test.c
```c
/*
 * Copyright (c) 2025 Nordic Semiconductor ASA
 *
 * SPDX-License-Identifier: Apache-2.0
 */

#include <stddef.h>
#include <errno.h>

#include "bs_sync.h"
#include <argparse.h>

#include <zephyr/kernel.h>
#include <zephyr/types.h>
#include <zephyr/bluetooth/bluetooth.h>
#include <zephyr/bluetooth/hci.h>
#include <zephyr/bluetooth/conn.h>
#include <zephyr/bluetooth/uuid.h>
#include <zephyr/bluetooth/gatt.h>

#include "babblekit/testcase.h"
#include "babblekit/flags.h"
#include "common.h"

#define TEST_CONN_PARAM BT_LE_CONN_PARAM(BT_GAP_INIT_CONN_INT_MIN, BT_GAP_INIT_CONN_INT_MAX, 0, \
					 BT_GAP_MS_TO_CONN_TIMEOUT(4000))

static void heavy_work_handler(struct k_work *work);
static K_WORK_DELAYABLE_DEFINE(heavy_work, heavy_work_handler);

static void heavy_work_handler(struct k_work *work)
{
	printk("Heavy work started");
	k_busy_wait(200 * 1000);
	printk("Heavy work done");

	k_work_schedule(&heavy_work, K_MSEC(100));
}

static void bs_sync_all_log(char *log_msg)
{
	/* Everyone meets here. */
	bt_testlib_bs_sync_all();

	if (get_device_nbr() == 0) {
		printk("Sync point: %s", log_msg);
	}

	/* Everyone waits for d0 to finish logging. */
	bt_testlib_bs_sync_all();
}

static const struct bt_uuid *test_svc_uuid = TEST_SERVICE_UUID;

struct server {
	atomic_t flag_is_connected;
	atomic_t flag_is_encrypted;
	atomic_t flag_discover_complete;
	atomic_t flag_long_subscribed;
	struct bt_conn *conn;
	uint16_t long_chrc_handle;
	size_t num_notifications;
};

static struct server servers[CONFIG_BT_MAX_CONN];

static struct server *server_alloc(void)
{
	for (size_t i = 0; i < ARRAY_SIZE(servers); i++) {
		if (servers[i].conn == NULL) {
			return &servers[i];
		}
	}

	return NULL;
}

static void server_free(struct server *server)
{
	server->conn = NULL;
}

static struct server *server_find(struct bt_conn *conn)
{
	for (size_t i = 0; i < ARRAY_SIZE(servers); i++) {
		if (servers[i].conn == conn) {
			return &servers[i];
		}
	}

	return NULL;
}

static void connected(struct bt_conn *conn, uint8_t err)
{
	char addr[BT_ADDR_LE_STR_LEN];
	struct server *server;

	server = server_alloc();
	__ASSERT(server != NULL, "No more servers available");

	server->conn = conn;

	bt_addr_le_to_str(bt_conn_get_dst(conn), addr, sizeof(addr));

	if (err != 0) {
		TEST_FAIL("Failed to connect to %s (%u)", addr, err);
		return;
	}

	printk("Connected to %s\n", addr);

	SET_FLAG(server->flag_is_connected);
}

static void disconnected(struct bt_conn *conn, uint8_t reason)
{
	char addr[BT_ADDR_LE_STR_LEN];
	struct server* server;

	server = server_find(conn);
	__ASSERT(server != NULL, "Unknown disconnection");

	bt_addr_le_to_str(bt_conn_get_dst(server->conn), addr, sizeof(addr));

	printk("Disconnected: %s (reason 0x%02x)\n", addr, reason);

	bt_conn_unref(server->conn);
	server_free(server);

	UNSET_FLAG(server->flag_is_connected);
}

void security_changed(struct bt_conn *conn, bt_security_t level, enum bt_security_err err)
{
	struct server* server;

	server = server_find(conn);
	__ASSERT(server != NULL, "Security change for unknown connection");

	if (err) {
		TEST_FAIL("Encryption failure (%d)", err);
	} else if (level < BT_SECURITY_L2) {
		TEST_FAIL("Insufficient sec level (%d)", level);
	} else {
		SET_FLAG(server->flag_is_encrypted);
	}
}

BT_CONN_CB_DEFINE(conn_callbacks) = {
	.connected = connected,
	.disconnected = disconnected,
	.security_changed = security_changed,
};

void device_found(const bt_addr_le_t *addr, int8_t rssi, uint8_t type, struct net_buf_simple *ad)
{
	char addr_str[BT_ADDR_LE_STR_LEN];
	int err;
	struct bt_conn *stub_conn = NULL;

	/* We're only interested in connectable events */
	if (type != BT_HCI_ADV_IND && type != BT_HCI_ADV_DIRECT_IND) {
		return;
	}

	bt_addr_le_to_str(addr, addr_str, sizeof(addr_str));
	printk("Device found: %s (RSSI %d)\n", addr_str, rssi);

	printk("Stopping scan\n");
	err = bt_le_scan_stop();
	if (err != 0) {
		TEST_FAIL("Could not stop scan: %d");
		return;
	}

	err = bt_conn_le_create(addr, BT_CONN_LE_CREATE_CONN, TEST_CONN_PARAM,
				&stub_conn);
	if (err != 0) {
		TEST_FAIL("Could not connect to peer: %d", err);
	}
}

static uint8_t discover_func(struct bt_conn *conn, const struct bt_gatt_attr *attr,
			     struct bt_gatt_discover_params *params)
{
	struct server* server;
	int err;

	server = server_find(conn);
	__ASSERT(server != NULL, "Discovery complete for unknown connection");

	if (attr == NULL) {
		if (server->long_chrc_handle == 0) {
			TEST_FAIL("Did not discover long_chrc (%x)", server->long_chrc_handle);
		}

		(void)memset(params, 0, sizeof(*params));

		SET_FLAG(server->flag_discover_complete);

		return BT_GATT_ITER_STOP;
	}

	printk("[ATTRIBUTE] handle %u\n", attr->handle);

	if (params->type == BT_GATT_DISCOVER_PRIMARY &&
	    bt_uuid_cmp(params->uuid, TEST_SERVICE_UUID) == 0) {
		printk("Found test service\n");
		params->uuid = NULL;
		params->start_handle = attr->handle + 1;
		params->type = BT_GATT_DISCOVER_CHARACTERISTIC;

		err = bt_gatt_discover(conn, params);
		if (err != 0) {
			TEST_FAIL("Discover failed (err %d)", err);
		}

		return BT_GATT_ITER_STOP;
	} else if (params->type == BT_GATT_DISCOVER_CHARACTERISTIC) {
		const struct bt_gatt_chrc *chrc = (struct bt_gatt_chrc *)attr->user_data;

		if (bt_uuid_cmp(chrc->uuid, TEST_CHRC_UUID) == 0) {
			printk("Found long_chrc\n");
			server->long_chrc_handle = chrc->value_handle;
		}
	}

	return BT_GATT_ITER_CONTINUE;
}

static void gatt_discover(struct server *server, enum bt_att_chan_opt opt)
{
	static struct bt_gatt_discover_params discover_params;
	int err;

	printk("Discovering services and characteristics\n");

	discover_params.uuid = test_svc_uuid;
	discover_params.func = discover_func;
	discover_params.start_handle = BT_ATT_FIRST_ATTRIBUTE_HANDLE;
	discover_params.end_handle = BT_ATT_LAST_ATTRIBUTE_HANDLE;
	discover_params.type = BT_GATT_DISCOVER_PRIMARY;
	discover_params.chan_opt = opt;

	err = bt_gatt_discover(server->conn, &discover_params);
	if (err != 0) {
		TEST_FAIL("Discover failed(err %d)", err);
	}

	WAIT_FOR_FLAG(server->flag_discover_complete);
	printk("Discovery complete\n");
}

static void test_long_subscribed(struct bt_conn *conn, uint8_t err,
				 struct bt_gatt_subscribe_params *params)
{
	struct server* server;

	server = server_find(conn);
	__ASSERT(server != NULL, "Long subscribe unknown connection");

	if (err) {
		TEST_FAIL("Subscribe failed (err %d)", err);
	}

	SET_FLAG(server->flag_long_subscribed);

	if (!params) {
		printk("params NULL\n");
		return;
	}

	if (params->value_handle == server->long_chrc_handle) {
		if ((params->value & BT_GATT_CCC_NOTIFY) == 0) {
			printk("Subscribed to long characteristic for server %d\n", ARRAY_INDEX(servers, server));
		} else {
			printk("Unsubscribed from long characteristic for server %d\n", ARRAY_INDEX(servers, server));
		}
	} else {
		TEST_FAIL("Unknown handle %d", params->value_handle);
	}
}

uint8_t test_notify(struct bt_conn *conn, struct bt_gatt_subscribe_params *params, const void *data,
		    uint16_t length)
{
	struct server* server;

	server = server_find(conn);
	__ASSERT(server != NULL, "Received notification for unknown connection");

	printk("Received notification #%u with length %d from server %d\n", server->num_notifications++, length, ARRAY_INDEX(servers, server));

	if (server->num_notifications == NOTIFICATION_COUNT) {
		printk("All notifications received from server %d\n", ARRAY_INDEX(servers, server));
	}

	/* This causes ACL data drop in HCI IPC driver. */
//	if (ARRAY_INDEX(servers, server) != 0) {
		k_sleep(K_MSEC(300));
//	}

	return BT_GATT_ITER_CONTINUE;
}

static struct bt_gatt_discover_params disc_params_long;
static struct bt_gatt_subscribe_params sub_params_long = {
	.notify = test_notify,
	.subscribe = test_long_subscribed,
	.ccc_handle = BT_GATT_AUTO_DISCOVER_CCC_HANDLE,
	.disc_params = &disc_params_long,
	.end_handle = BT_ATT_LAST_ATTRIBUTE_HANDLE,
	.value = BT_GATT_CCC_NOTIFY,
};

static void gatt_subscribe_long(struct server *server, enum bt_att_chan_opt opt)
{
	int err;

	UNSET_FLAG(server->flag_long_subscribed);
	sub_params_long.value_handle = server->long_chrc_handle;
	sub_params_long.chan_opt = opt;
	err = bt_gatt_subscribe(server->conn, &sub_params_long);
	if (err < 0) {
		TEST_FAIL("Failed to subscribe: %d", err);
	} else {
		printk("Subscribe request sent\n");
	}
}

static void gatt_unsubscribe_long(struct server *server, enum bt_att_chan_opt opt)
{
	int err;

	UNSET_FLAG(server->flag_long_subscribed);
	sub_params_long.value_handle = server->long_chrc_handle;
	sub_params_long.chan_opt = opt;
	err = bt_gatt_unsubscribe(server->conn, &sub_params_long);
	if (err < 0) {
		TEST_FAIL("Failed to unsubscribe: %d", err);
	} else {
		printk("Unsubscribe request sent\n");
	}
}

static void setup(void)
{
	int err;

	err = bt_enable(NULL);
	if (err != 0) {
		TEST_FAIL("Bluetooth discover failed (err %d)", err);
	}

	for (size_t i = 0; i < CONFIG_BT_MAX_CONN; i++) {
		struct server *server;

		printk("Connection to %d device...\n", i);

		err = bt_le_scan_start(BT_LE_SCAN_PASSIVE, device_found);
		if (err != 0) {
			TEST_FAIL("Scanning failed to start (err %d)", err);
		}

		printk("Scanning successfully started\n");

		/* TODO: This code is bug-prone as server_alloc may not allocate in the same order
		 * as the loop.
		 */
		server = &servers[i];

		WAIT_FOR_FLAG(server->flag_is_connected);

		err = bt_conn_set_security(server->conn, BT_SECURITY_L2);
		if (err) {
			TEST_FAIL("Starting encryption procedure failed (%d)", err);
		}

		WAIT_FOR_FLAG(server->flag_is_encrypted);

		while (bt_eatt_count(server->conn) < CONFIG_BT_EATT_MAX) {
			k_sleep(K_MSEC(10));
		}

		printk("EATT connected\n");
	}
}

static void test_main_client(void)
{
	setup();

	for (size_t i = 0; i < CONFIG_BT_MAX_CONN; i++) {
		struct server *server = &servers[i];

		gatt_discover(server, BT_ATT_CHAN_OPT_ENHANCED_ONLY);
	}

	for (size_t i = 0; i < CONFIG_BT_MAX_CONN; i++) {
		struct server *server = &servers[i];

		gatt_subscribe_long(server, BT_ATT_CHAN_OPT_ENHANCED_ONLY);
		WAIT_FOR_FLAG(server->flag_long_subscribed);

		printk("Server %d subscribed\n", i);
	}

	printk("All servers subscribed\n");

	uint32_t num_notifications;

	bs_sync_all_log("Syncing with peripherals");

	k_sleep(K_MSEC(800));
	k_work_schedule(&heavy_work, K_NO_WAIT);

	do {
		k_sleep(K_MSEC(100));

		num_notifications = 0;
		for (size_t i = 0; i < CONFIG_BT_MAX_CONN; i++) {
			struct server *server = &servers[i];

			num_notifications += server->num_notifications;
		}
	} while (num_notifications < NOTIFICATION_COUNT * ARRAY_SIZE(servers));

	printk("All notifications received\n");

	for (size_t i = 0; i < CONFIG_BT_MAX_CONN; i++) {
		struct server *server = &servers[i];

//		if (server->conn == NULL) {
//			continue;
//		}

		gatt_unsubscribe_long(server, BT_ATT_CHAN_OPT_ENHANCED_ONLY);
		WAIT_FOR_FLAG(server->flag_long_subscribed);

		printk("Server %d unsubscribed\n", i);
	}

	TEST_PASS("GATT client Passed");
}

static const struct bst_test_instance test_vcs[] = {
	{
		.test_id = "gatt_client_enhanced_notif_stress",
		.test_main_f = test_main_client,
	},
	BSTEST_END_MARKER,
};

struct bst_test_list *test_gatt_client_install(struct bst_test_list *tests)
{
	return bst_add_tests(tests, test_vcs);
}
```

## src/gatt_server_test.c
```c
/*
 * Copyright (c) 2025 Nordic Semiconductor ASA
 *
 * SPDX-License-Identifier: Apache-2.0
 */

#include <stddef.h>
#include <errno.h>

#include <zephyr/kernel.h>
#include <zephyr/types.h>
#include <zephyr/bluetooth/bluetooth.h>
#include <zephyr/bluetooth/hci.h>
#include <zephyr/bluetooth/conn.h>
#include <zephyr/bluetooth/uuid.h>
#include <zephyr/bluetooth/gatt.h>

#include "babblekit/testcase.h"
#include "babblekit/flags.h"
#include "common.h"

extern enum bst_result_t bst_result;

DEFINE_FLAG_STATIC(flag_is_connected);
DEFINE_FLAG_STATIC(flag_subscribe);

static struct bt_conn *g_conn;

#define ARRAY_ITEM(i, _) i
const uint8_t chrc_data[] = { LISTIFY(CHRC_SIZE, ARRAY_ITEM, (,)) }; /* 1, 2, 3 ... */

static void connected(struct bt_conn *conn, uint8_t err)
{
	char addr[BT_ADDR_LE_STR_LEN];

	bt_addr_le_to_str(bt_conn_get_dst(conn), addr, sizeof(addr));

	if (err != 0) {
		TEST_FAIL("Failed to connect to %s (%u)", addr, err);
		return;
	}

	printk("Connected to %s\n", addr);

	g_conn = bt_conn_ref(conn);
	SET_FLAG(flag_is_connected);
}

static void disconnected(struct bt_conn *conn, uint8_t reason)
{
	char addr[BT_ADDR_LE_STR_LEN];

	if (conn != g_conn) {
		return;
	}

	bt_addr_le_to_str(bt_conn_get_dst(conn), addr, sizeof(addr));

	printk("Disconnected: %s (reason 0x%02x)\n", addr, reason);

	bt_conn_unref(g_conn);

	g_conn = NULL;
	UNSET_FLAG(flag_is_connected);
}

BT_CONN_CB_DEFINE(conn_callbacks) = {
	.connected = connected,
	.disconnected = disconnected,
};

static ssize_t read_test_chrc(struct bt_conn *conn, const struct bt_gatt_attr *attr, void *buf,
				   uint16_t len, uint16_t offset)
{
	printk("Read char\n");
	return bt_gatt_attr_read(conn, attr, buf, len, offset, (void *)chrc_data,
				 sizeof(chrc_data));
}

static void subscribe(const struct bt_gatt_attr *attr, uint16_t value)
{
	const bool notif_enabled = (value == BT_GATT_CCC_NOTIFY);

	if (notif_enabled) {
		SET_FLAG(flag_subscribe);
	}

	printk("Notifications %s\n", notif_enabled ? "enabled" : "disabled");
}

BT_GATT_SERVICE_DEFINE(test_svc, BT_GATT_PRIMARY_SERVICE(TEST_SERVICE_UUID),
		       BT_GATT_CHARACTERISTIC(TEST_CHRC_UUID,
					      BT_GATT_CHRC_NOTIFY | BT_GATT_CHRC_READ,
					      BT_GATT_PERM_READ, read_test_chrc, NULL, NULL),
		       BT_GATT_CCC(subscribe, BT_GATT_PERM_READ | BT_GATT_PERM_WRITE));

static volatile size_t num_notifications_sent;

static void notification_sent(struct bt_conn *conn, void *user_data)
{
	size_t *length = user_data;

	printk("Sent notification #%u with length %d\n", num_notifications_sent++, *length);
}

static void notify(void)
{
	static size_t length = CHRC_SIZE;
	static struct bt_gatt_notify_params params = {
		.attr = &attr_test_svc[1],
		.data = chrc_data,
		.len = CHRC_SIZE,
		.func = notification_sent,
		.user_data = &length,
		.uuid = NULL,
		.chan_opt = BT_ATT_CHAN_OPT_ENHANCED_ONLY,
	};
	int err;

	do {
		err = bt_gatt_notify_cb(g_conn, &params);

		if (err == -ENOMEM) {
			/* The delay is needed to schedule other threads, but keep it as short as
			 * possible.
			 */
			k_sleep(K_MSEC(1));
		} else if (err) {
			TEST_FAIL("Notify failed (err %d)", err);
		}
	} while (err);
}

static void setup(void)
{
	int err;
	const struct bt_data ad[] = {
		BT_DATA_BYTES(BT_DATA_FLAGS, (BT_LE_AD_GENERAL | BT_LE_AD_NO_BREDR)),
	};

	err = bt_enable(NULL);
	if (err != 0) {
		TEST_FAIL("Bluetooth init failed (err %d)", err);
		return;
	}

	printk("Bluetooth initialized\n");

	err = bt_le_adv_start(BT_LE_ADV_CONN_FAST_1, ad, ARRAY_SIZE(ad), NULL, 0);
	if (err != 0) {
		TEST_FAIL("Advertising failed to start (err %d)", err);
		return;
	}

	printk("Advertising successfully started\n");

	WAIT_FOR_FLAG(flag_is_connected);

	while (bt_eatt_count(g_conn) < CONFIG_BT_EATT_MAX) {
		k_sleep(K_MSEC(100));
	}
	printk("EATT connected\n");

	WAIT_FOR_FLAG(flag_subscribe);
}

static void test_main_server(void)
{
	setup();

	k_sleep(K_SECONDS(5));

	for (int i = 0; i < NOTIFICATION_COUNT; i++) {
		notify();
	}

	while (num_notifications_sent < NOTIFICATION_COUNT) {
		k_sleep(K_MSEC(100));
	}

	TEST_PASS("GATT server passed");
}

static const struct bst_test_instance test_gatt_server[] = {
	{
		.test_id = "gatt_server_enhanced_notif_stress",
		.test_main_f = test_main_server,
	},
	BSTEST_END_MARKER,
};

struct bst_test_list *test_gatt_server_install(struct bst_test_list *tests)
{
	return bst_add_tests(tests, test_gatt_server);
}
```
