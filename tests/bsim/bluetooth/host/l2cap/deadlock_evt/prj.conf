## prj.conf
```kconfig
CONFIG_BT=y
CONFIG_BT_EXT_ADV=y
CONFIG_BT_CTLR_DATA_LENGTH_MAX=251
CONFIG_BT_CTLR_ADV_DATA_LEN_MAX=191
CONFIG_SETTINGS=y
CONFIG_BT_CONN_TX_NOTIFY_WQ=n
CONFIG_FLASH=y
CONFIG_FLASH_MAP=y
CONFIG_BT_SETTINGS=y
CONFIG_NVS=y
CONFIG_BT_CENTRAL=y
CONFIG_BT_PERIPHERAL=y
CONFIG_BT_DEVICE_NAME="L2CAP stress test"

CONFIG_BT_EATT=n
CONFIG_BT_L2CAP_ECRED=n

CONFIG_BT_SMP=y # Next config depends on it
CONFIG_BT_L2CAP_DYNAMIC_CHANNEL=y

# Disable auto-initiated procedures so they don't
# mess with the test's execution.
CONFIG_BT_AUTO_PHY_UPDATE=n
CONFIG_BT_AUTO_DATA_LEN_UPDATE=n
CONFIG_BT_GAP_AUTO_UPDATE_CONN_PARAMS=n

# L2CAP MPS
# 23+27+27=77 makes exactly three full packets
CONFIG_BT_L2CAP_TX_MTU=77

# Use this to send L2CAP PDUs without any fragmentation.
# In this particular case, we prefer fragmenting to test that code path.
# CONFIG_BT_BUF_ACL_TX_SIZE=81

# L2CAP PDUs will be fragmented in 3 ACL packets.
CONFIG_BT_BUF_ACL_TX_SIZE=27

CONFIG_BT_BUF_ACL_TX_COUNT=2

# The minimum value for this is
# L2AP MPS + L2CAP header (4)
CONFIG_BT_BUF_ACL_RX_SIZE=81

# Governs BT_CONN_TX_MAX, and so must be >= than the max number of
# peers, since we attempt to send one SDU per peer. The test execution
# is a bit slowed down by having this at the very minimum, but we want
# to keep it that way as to stress the stack as much as possible.
CONFIG_BT_L2CAP_TX_BUF_COUNT=4

CONFIG_BT_CTLR_DATA_LENGTH_MAX=81
CONFIG_BT_CTLR_RX_BUFFERS=10

CONFIG_BT_MAX_CONN=1

CONFIG_LOG=y
CONFIG_ASSERT=y
CONFIG_NET_BUF_POOL_USAGE=y

# CONFIG_BT_L2CAP_LOG_LEVEL_DBG=y
# CONFIG_BT_CONN_LOG_LEVEL_DBG=y
CONFIG_LOG_THREAD_ID_PREFIX=y
CONFIG_THREAD_NAME=y

CONFIG_ARCH_POSIX_TRAP_ON_FATAL=y

# Must be enabled to reproduce the issue
#CONFIG_BT_HCI_ACL_FLOW_CONTROL=n
CONFIG_BT_HCI_ACL_FLOW_CONTROL=y

# Must be enabled to reproduce the issue
CONFIG_SOC_FLASH_NRF_PARTIAL_ERASE=y

# Since Flow Control is disabled, it doesn't matter which _RX_COUNT is increased as the max value is
# taken.

# >>>
# DEADLOCK_FLASH
# The following configuration never works with and without CONFIG_BT_CONN_TX_NOTIFY_WQ enabled:
#CONFIG_BT_CONN_TX_NOTIFY_WQ=y
#CONFIG_BT_BUF_ACL_RX_COUNT=2
#CONFIG_BT_BUF_EVT_RX_COUNT=2

# The following configuration works with CONFIG_BT_CONN_TX_NOTIFY_WQ enabled but doesn't work
# without it:
#CONFIG_BT_CONN_TX_NOTIFY_WQ=y
#CONFIG_BT_BUF_ACL_RX_COUNT=2
#CONFIG_BT_BUF_EVT_RX_COUNT=4
# <<<

# >>>
# DEADLOCK_HOST
CONFIG_BT_CONN_TX_NOTIFY_WQ=y
#CONFIG_BT_BUF_ACL_RX_COUNT=2
CONFIG_BT_BUF_EVT_RX_COUNT=2
# <<<

CONFIG_BT_LL_SW_SPLIT=y

CONFIG_BT_SMP_SC_PAIR_ONLY=n
```

## nrf5340_cpunet-bt_ll_sw_split.conf
```kconfig
CONFIG_IPC_SERVICE=y
CONFIG_MBOX=y

CONFIG_ISR_STACK_SIZE=1024
CONFIG_IDLE_STACK_SIZE=256
CONFIG_MAIN_STACK_SIZE=512
CONFIG_SYSTEM_WORKQUEUE_STACK_SIZE=512
CONFIG_IPC_SERVICE_BACKEND_RPMSG_WQ_STACK_SIZE=512
CONFIG_HEAP_MEM_POOL_SIZE=8192
CONFIG_CBPRINTF_REDUCED_INTEGRAL=y

CONFIG_ISR_TABLES_LOCAL_DECLARATION=y
CONFIG_LTO=y

CONFIG_BT=y
CONFIG_BT_HCI_RAW=y
CONFIG_BT_MAX_CONN=3

# Workaround: Unable to allocate command buffer when using K_NO_WAIT since
# Host number of completed commands does not follow normal flow control.
CONFIG_BT_BUF_CMD_TX_COUNT=10

CONFIG_BT_BUF_EVT_RX_COUNT=16

CONFIG_BT_BUF_ACL_RX_SIZE=81
CONFIG_BT_BUF_ACL_TX_SIZE=27
CONFIG_BT_CTLR_DATA_LENGTH_MAX=81
CONFIG_BT_CTLR_ADV_DATA_LEN_MAX=191

CONFIG_BT_CTLR_RX_BUFFERS=10

# Host features
CONFIG_BT_EXT_ADV=y

# Controller
CONFIG_BT_LL_SW_SPLIT=y
CONFIG_BT_CTLR_ASSERT_HANDLER=y
#CONFIG_BT_CTLR_DTM_HCI=y

# Advertising Sets and Extended Scanning
CONFIG_BT_CTLR_ADV_EXT=y
CONFIG_BT_CTLR_SCAN_DATA_LEN_MAX=1650

# Increase the below to receive interleaved advertising chains
CONFIG_BT_CTLR_SCAN_AUX_SET=1

CONFIG_BT_CTLR_LLCP_CONN=1

CONFIG_BT_CTLR_ADV_RESERVE_MAX=n
CONFIG_BT_CTLR_CENTRAL_RESERVE_MAX=n
CONFIG_BT_CTLR_SLOT_RESERVATION_UPDATE=n
CONFIG_BT_CTLR_SCAN_UNRESERVED=y

CONFIG_BT_CTLR_LLCP_REMOTE_PROC_CTX_BUF_NUM=1
CONFIG_BT_CTLR_FORCE_MD_COUNT=0
```

## src/main.c
```c
/*
 * Copyright (c) 2024 Nordic Semiconductor
 *
 * SPDX-License-Identifier: Apache-2.0
 */

#include "bstests.h"
#include "common.h"

#include "host/conn_internal.h"

#include <zephyr/settings/settings.h>
#include <zephyr/storage/flash_map.h>

#include "host/hci_core.h"

#define LOG_MODULE_NAME main
#include <zephyr/logging/log.h>
LOG_MODULE_REGISTER(LOG_MODULE_NAME, LOG_LEVEL_DBG);

static struct k_work_q dut_work_q;
static K_THREAD_STACK_DEFINE(dut_work_stack, 1024);

static void heavy_work_handler(struct k_work *work)
{
	LOG_DBG("Heavy work started");
	k_busy_wait(100 * 1000);
	LOG_DBG("Heavy work done");

	k_sleep(K_MSEC(1));
//	k_work_submit_to_queue(&dut_work_q, work);
}

static K_WORK_DEFINE(heavy_work, heavy_work_handler);

static void scan_cb(const bt_addr_le_t *addr, int8_t rssi,
		    uint8_t adv_type, struct net_buf_simple *buf)
{
	//LOG_HEXDUMP_DBG(buf->data, buf->len, "Recvd adv report");

#if 1
	uint16_t tx_octets;
	uint16_t tx_time;
	int err;

	err = bt_hci_le_read_max_data_len(&tx_octets, &tx_time);
	if (err) {
		FAIL("Failed to read max data len (err %d)", err);
	}

	//LOG_WRN("Max data len: %u, max tx time: %u", tx_octets, tx_time);
#else
	struct bt_conn_le_tx_power power_level = {0};
	int err;
	err = bt_conn_le_get_tx_power_level(default_conn, &power_level);
	if (err) {
		FAIL("Failed to get tx power level (err %d)", err);
	}

	printf("Tx power level: %d\n", power_level.current_level);
#endif
}

#define BT_MESH_ADV_SCAN_UNIT(_ms) ((_ms) * 8 / 5)

int scan_enable(void)
{
	struct bt_le_scan_param scan_param = {
		.type = BT_LE_SCAN_TYPE_PASSIVE,
		.interval = BT_MESH_ADV_SCAN_UNIT(30),
		.window = BT_MESH_ADV_SCAN_UNIT(30),
	};
	int err;

	LOG_DBG("");

	err = bt_le_scan_start(&scan_param, scan_cb);
	if (err && err != -EALREADY) {
		LOG_ERR("starting scan failed (err %d)", err);
		return err;
	}

	return 0;
}

static void test_dut_main(void)
{
	LOG_DBG("DUT deadlock started");
	int err;

	err = bt_enable(NULL);
	if (err) {
		FAIL("Can't enable Bluetooth (err %d)", err);
		return;
	}

	(void)settings_load();

	k_work_queue_start(&dut_work_q, dut_work_stack,
			   K_THREAD_STACK_SIZEOF(dut_work_stack),
			   K_PRIO_COOP(CONFIG_BT_RX_PRIO + 1), NULL);
	k_thread_name_set(&dut_work_q.thread, "DUT workq");

	err = scan_enable();
	if (err) {
		FAIL("Scanning failed to start (err %d)", err);
		return;
	}

	k_sleep(K_SECONDS(2));

	k_work_submit_to_queue(&dut_work_q, &heavy_work);

	k_sleep(K_SECONDS(60));

	PASS("DUT deadlock test passed\n");
}

#define ADV_INT_FAST_MS    20
#define ADV_WORKQ_NUM_THREADS 1

static struct k_work_q adv_work_q[ADV_WORKQ_NUM_THREADS];
static K_THREAD_STACK_ARRAY_DEFINE(adv_work_stack, ADV_WORKQ_NUM_THREADS, 1024);
static struct k_work adv_work[ADV_WORKQ_NUM_THREADS];
static struct bt_le_ext_adv *adv_sets[ADV_WORKQ_NUM_THREADS];

static void adv_sent_cb(struct bt_le_ext_adv *instance, struct bt_le_ext_adv_sent_info *info)
{
	int i;
	int err;
	for (i = 0; i < ADV_WORKQ_NUM_THREADS; i++) {
		if (adv_sets[i] == instance) {
			break;
		}
	}
	__ASSERT_NO_MSG(i < ADV_WORKQ_NUM_THREADS);
	err = k_work_submit_to_queue(&adv_work_q[i], &adv_work[i]);
	if (err < 0) {
		FAIL("Failed to submit adv work[%d] (err: %d)", i, err);
	}
}

static int send_adv(struct bt_le_ext_adv *instance)
{
	int err;
	NET_BUF_SIMPLE_DEFINE(buf, 100);
	net_buf_simple_init(&buf, 0);

	net_buf_simple_add(&buf, 60);

	struct bt_le_ext_adv_start_param start = {
		.num_events = 1,
	};

	struct bt_data ad;
	ad.type = BT_DATA_MESH_MESSAGE;
	ad.data_len = buf.len;
	ad.data = buf.data;

	err = bt_le_ext_adv_set_data(instance, &ad, 1, NULL, 0);
	if (err) {
		LOG_ERR("Failed to set adv data (err: %d)", err);
		FAIL("");
		return err;
	}

	err = bt_le_ext_adv_start(instance, &start);
	if (err) {
		LOG_ERR("Failed to start adv (err: %d)", err);
		FAIL("");
		return err;
	}

	return 0;
}

static void adv_work_handler(struct k_work *work)
{
	int i;
	int err;

	i = ARRAY_INDEX(adv_work, work);
	err = send_adv(adv_sets[i]);
	if (err) {
		LOG_ERR("Failed to send adv (err: %d) from adv[%d], resubmitting", err, i);
		err = k_work_submit_to_queue(&adv_work_q[i], work);
		if (err < 0) {
			FAIL("Failed to resubmit adv work[%d] (err: %d)", i, err);
		}
	}
}

static void advertisers_setup(void)
{
	static const struct bt_le_ext_adv_cb adv_cb = { .sent = adv_sent_cb };
	struct bt_le_adv_param adv_param = {
		.id = BT_ID_DEFAULT,
		.options = BT_LE_ADV_OPT_EXT_ADV,
		.interval_min = BT_MESH_ADV_SCAN_UNIT(ADV_INT_FAST_MS),
		.interval_max = BT_MESH_ADV_SCAN_UNIT(ADV_INT_FAST_MS)
	};
	int err;
	for (int i = 0; i < ADV_WORKQ_NUM_THREADS; i++) {
		k_work_queue_start(&adv_work_q[i], adv_work_stack[i],
				   K_THREAD_STACK_SIZEOF(adv_work_stack[i]),
				   K_PRIO_COOP(1), NULL);
		k_thread_name_set(&adv_work_q[i].thread, "Test adv workq");
		k_work_init(&adv_work[i], adv_work_handler);
		err = bt_le_ext_adv_create(&adv_param, &adv_cb, &adv_sets[i]);
		if (err) {
			FAIL("Failed to create advertiser instance[%d] (err: %d)", i, err);
		}
	}
	for (int i = 0; i < ADV_WORKQ_NUM_THREADS; i++) {
		err = k_work_submit_to_queue(&adv_work_q[i], &adv_work[i]);
		if (err < 0) {
			FAIL("Failed to submit adv work[%d] (err: %d)", i, err);
		}
	}
}

static void test_tester_adv_main(void)
{
	int err;

	LOG_DBG("Tester deadlock started");

	err = bt_enable(NULL);
	ASSERT(err == 0, "Can't enable Bluetooth (err %d)\n", err);
	LOG_DBG("Central Bluetooth initialized.");

	(void)settings_load();

	advertisers_setup();

	PASS("Tester adv deadlock passed\n");
}

static const struct bst_test_instance test_def[] = {
	{
		.test_id = "dut",
		.test_descr = "DUT acting as peripheral",
		.test_pre_init_f = test_init,
		.test_tick_f = test_tick,
		.test_main_f = test_dut_main
	},
	{
		.test_id = "tester_adv",
		.test_descr = "Tester acting as advertiser",
		.test_pre_init_f = test_init,
		.test_tick_f = test_tick,
		.test_main_f = test_tester_adv_main
	},
	BSTEST_END_MARKER
};

struct bst_test_list *test_main_l2cap_deadlock_install(struct bst_test_list *tests)
{
	return bst_add_tests(tests, test_def);
}

bst_test_install_t test_installers[] = {
	test_main_l2cap_deadlock_install,
	NULL
};

int main(void)
{
	bst_main();
	return 0;
}
```
